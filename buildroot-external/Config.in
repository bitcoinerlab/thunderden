## buildroot-external/Config.in
```kconfig
menu "Thunder Den"

comment "Use thunderden_x86_64_defconfig from this external tree"

source "$BR2_EXTERNAL_THUNDERDEN_PATH/package/thunderden-qrscan/Config.in"

endmenu
```

## buildroot-external/configs/thunderden_x86_64_defconfig
```kconfig
BR2_x86_64=y
BR2_PACKAGE_HOST_LINUX_HEADERS_CUSTOM_6_18=y
BR2_TOOLCHAIN_BUILDROOT_CXX=y
BR2_DOWNLOAD_FORCE_CHECK_HASHES=y
BR2_TARGET_GENERIC_HOSTNAME="thunderden"
BR2_TARGET_GENERIC_ISSUE="Thunder Den"
# BR2_TARGET_GENERIC_GETTY is not set
BR2_SYSTEM_BIN_SH_BASH=y
BR2_SYSTEM_DHCP=""
# BR2_PACKAGE_IFUPDOWN_SCRIPTS is not set
BR2_ROOTFS_OVERLAY="$(BR2_EXTERNAL_THUNDERDEN_PATH)/board/thunderden/rootfs-overlay"
BR2_ROOTFS_POST_BUILD_SCRIPT="$(BR2_EXTERNAL_THUNDERDEN_PATH)/board/thunderden/post-build.sh"
BR2_ROOTFS_POST_IMAGE_SCRIPT="$(BR2_EXTERNAL_THUNDERDEN_PATH)/board/thunderden/post-image.sh"
BR2_GLOBAL_PATCH_DIR="$(BR2_EXTERNAL_THUNDERDEN_PATH)/patches"
BR2_LINUX_KERNEL=y
BR2_LINUX_KERNEL_LATEST_VERSION=y
BR2_LINUX_KERNEL_USE_CUSTOM_CONFIG=y
BR2_LINUX_KERNEL_CUSTOM_CONFIG_FILE="$(BR2_EXTERNAL_THUNDERDEN_PATH)/board/thunderden/linux.config"
BR2_LINUX_KERNEL_NEEDS_HOST_LIBELF=y
BR2_TARGET_ROOTFS_INITRAMFS=y
BR2_TARGET_GRUB2=y
BR2_TARGET_GRUB2_I386_PC=y
BR2_TARGET_GRUB2_X86_64_EFI=y
BR2_TARGET_GRUB2_BOOT_PARTITION="hd0,msdos1"
BR2_PACKAGE_BUSYBOX_SHOW_OTHERS=y
BR2_PACKAGE_BASH=y
BR2_PACKAGE_COREUTILS=y
BR2_PACKAGE_BC=y
BR2_PACKAGE_OPENSSL=y
BR2_PACKAGE_LIBOPENSSL_BIN=y
BR2_PACKAGE_KMOD=y
BR2_PACKAGE_LIBQRENCODE=y
BR2_PACKAGE_LIBQRENCODE_TOOLS=y
BR2_PACKAGE_FBV=y
BR2_PACKAGE_V4L2GRAB=y
BR2_PACKAGE_ZBAR=y
BR2_PACKAGE_BITCOIN=y
BR2_PACKAGE_HOST_DOSFSTOOLS=y
BR2_PACKAGE_HOST_GENIMAGE=y
BR2_PACKAGE_HOST_MTOOLS=y
```

## buildroot-external/package/thunderden-qrscan/Config.in
```kconfig
config BR2_PACKAGE_THUNDERDEN_QRSCAN
	bool "thunderden-qrscan"
	depends on BR2_PACKAGE_ZBAR
	select BR2_PACKAGE_ZLIB
	help
	  Thunder Den QR scanner helper with single-process camera ownership.
	  It renders a framebuffer preview while scanning QR payloads and prints
	  a normalized base64 PSBT to stdout.
```

## platform/Config.in
```kconfig
source "$BR2_EXTERNAL_THUNDERDEN_PATH/package/thunderden/Config.in"
source "$BR2_EXTERNAL_THUNDERDEN_PATH/package/td-divsufsort/Config.in"
```

## platform/defconfig
```kconfig
BR2_x86_64=y
BR2_x86_x86_64=y
BR2_JLEVEL=4
BR2_TOOLCHAIN_BUILDROOT_GLIBC=y
BR2_TOOLCHAIN_BUILDROOT_CXX=y
BR2_PACKAGE_HOST_LINUX_HEADERS_CUSTOM_7_0=y
BR2_USE_WCHAR=y
BR2_DOWNLOAD_FORCE_CHECK_HASHES=y
BR2_REPRODUCIBLE=y
BR2_TARGET_GENERIC_HOSTNAME="thunderden"
# BR2_TARGET_GENERIC_GETTY is not set
BR2_SYSTEM_DHCP=""
# BR2_PACKAGE_IFUPDOWN_SCRIPTS is not set
BR2_ROOTFS_OVERLAY="$(BR2_EXTERNAL_THUNDERDEN_PATH)/overlay"
BR2_ROOTFS_POST_BUILD_SCRIPT="$(BR2_EXTERNAL_THUNDERDEN_PATH)/post-build.sh"
BR2_GLOBAL_PATCH_DIR="/tmp/thunderden-hashes"
BR2_LINUX_KERNEL=y
BR2_LINUX_KERNEL_CUSTOM_VERSION=y
BR2_LINUX_KERNEL_USE_CUSTOM_CONFIG=y
BR2_LINUX_KERNEL_CUSTOM_CONFIG_FILE="$(BR2_EXTERNAL_THUNDERDEN_PATH)/linux.config"
BR2_LINUX_KERNEL_NEEDS_HOST_LIBELF=y
BR2_TARGET_ROOTFS_INITRAMFS=y
BR2_TARGET_GRUB2=y
BR2_TARGET_GRUB2_I386_PC=y
BR2_TARGET_GRUB2_X86_64_EFI=y
BR2_TARGET_GRUB2_BOOT_PARTITION="hd0,msdos1"
BR2_TARGET_GRUB2_BUILTIN_MODULES_PC="boot linux fat part_msdos normal biosdisk vbe video_bochs video_cirrus"
BR2_TARGET_GRUB2_BUILTIN_MODULES_EFI="boot linux fat part_msdos normal efi_gop"
BR2_PACKAGE_THUNDERDEN=y
BR2_PACKAGE_HOST_DOSFSTOOLS=y
BR2_PACKAGE_HOST_MTOOLS=y
```

## platform/package/td-opencv/Config.in
```kconfig
config BR2_PACKAGE_TD_OPENCV
	bool "CPU OCR image processing and inference"
	depends on BR2_INSTALL_LIBSTDCPP
	depends on BR2_TOOLCHAIN_HAS_THREADS
	depends on BR2_USE_WCHAR
```

## platform/package/thunderden/Config.in
```kconfig
config BR2_PACKAGE_THUNDERDEN
	bool "thunderden"
	depends on BR2_INSTALL_LIBSTDCPP
	depends on BR2_TOOLCHAIN_HAS_THREADS
	depends on BR2_USE_WCHAR
	select BR2_PACKAGE_BOOST
	select BR2_PACKAGE_OPENSSL
	select BR2_PACKAGE_ZBAR
	select BR2_PACKAGE_LIBQRENCODE
```
